/******************************************************************************
Copyright (c) 2019 released Swadha Energies Pvt. Ltd.  All rights reserved.
******************************************************************************/

#include "glcd.h"
#include <stdint.h>
#include <stdbool.h>
#include <string.h>
#include <stdlib.h>
#include <stdio.h>
#include "Keypad_Driver.h"
#include "Menu.h"
#include "Drive_Communication.h"
#include "stm32f1xx_it.h"
#include "Timer.h"
#include "general/general.h"
#include "Algo.h"
#include "Auto_Algo.h"
#include "FRAM.h"
#include "sensor-card-data.h"
#include "vav-communication.h"
#include "lwip.h"
#include "config.h"
#include "ADC.h"
#include "cjson_packet.h"
#include "modbus_master.h"
#define PIN_D0                          GPIO_PIN_15
#define PIN_D1                          GPIO_PIN_4
#define PIN_D2                          GPIO_PIN_3
#define PIN_D3                          GPIO_PIN_12
#define PIN_D4                          GPIO_PIN_2
#define PIN_D5                          GPIO_PIN_1
#define PIN_D6                          GPIO_PIN_0
#define PIN_D7                          GPIO_PIN_6
#define PIN_A0                          GPIO_PIN_13
#define PIN_RS                          GPIO_PIN_14
#define PIN_WR                          GPIO_PIN_7
#define DISPLAY_PORT1                   GPIOD
#define DISPLAY_PORT2                   GPIOC

struct TstDisplayParam DisplayParam_data;
struct stRS485Params glcdRS485Params;
struct TstMenuParam MenuParam_data;
struct FACIAQ_data_tag stIAQdata;

static struct TstMenuItems display_set;

struct stRelayModbusdata relaybus[5];
//struct stReceivedModbusData modbus_lcd[5];
float freq=0;
void
fvMenuParamRead(struct TstMenuParam *stMenuParam_data)
{
  memcpy(stMenuParam_data,&MenuParam_data,sizeof(struct TstMenuParam));
}

void
fvMenuParamWrite(struct TstMenuParam *stMenuParam_data)
{
  memcpy(&MenuParam_data,stMenuParam_data,sizeof(struct TstMenuParam));
}

void
fvDisplayParamRead(struct TstDisplayParam *stDisplayParam_data)
{
  memcpy(stDisplayParam_data,&DisplayParam_data,sizeof(struct TstDisplayParam));
}

void
fvDisplayParamWrite(struct TstDisplayParam *stDisplayParam_data)
{
  memcpy(&DisplayParam_data,stDisplayParam_data,sizeof(struct TstDisplayParam));
}


const uint8_t page2_space[] = {0x0,0x0,0x0,0x0,0x0,0x0,0x0,0x0,0x0,0x0,0x0,0x0,0x0,0x0,0x0,0x0,0x0,0x0,0x0,0x0,0x0,0x0};
const uint8_t page2_tick[] = {0x0,0x0,0x0,0x0,0x0,0x0,0x0,0x0,0xc0,0xc0,0x30,0xff,0xff,0x30,0x30,0xc,0xc,0x3,0x3,0x0,0x0,0x0};
const uint8_t page2_double_qoutes[] = {0x0,0x0,0x3f,0x3f,0x0,0x0,0x3f,0x3f,0x0,0x0,0x0,0x0,0x0,0x0,0x0,0x0,0x0,0x0,0x0,0x0,0x0,0x0};
const uint8_t page2_cross[] = {0x30,0x30,0xc0,0xc0,0x0,0x0,0x0,0x0,0xc0,0xc0,0x30,0xc0,0xc0,0x30,0x30,0xf,0xf,0xf,0xf,0x30,0x30,0xc0};
const uint8_t page2_dollar[] = {0x30,0x30,0xcc,0xcc,0xff,0xff,0xcc,0xcc,0xc,0xc,0x0,0xc,0xc,0xc,0xc,0x3f,0x3f,0xc,0xc,0x3,0x3,0x0};
const uint8_t page2_percentage[] = {0xf,0xf,0xf,0xf,0xc0,0xc0,0x30,0x30,0xc,0xc,0x0,0xc,0xc,0x3,0x3,0x0,0x0,0x3c,0x3c,0x3c,0x3c,0x0};
const uint8_t page2_ampercent[] = {0x3c,0x3c,0xc3,0xc3,0x33,0x33,0xc,0xc,0x0,0x0,0x0,0xf,0xf,0x30,0x30,0x33,0x33,0xc,0xc,0x33,0x33,0x0};
const uint8_t page2_qoute[] = {0x0,0x0,0x33,0x33,0xf,0xf,0x0,0x0,0x0,0x0,0x0,0x0,0x0,0x0,0x0,0x0,0x0,0x0,0x0,0x0,0x0,0x0};
const uint8_t page2_open_simple_bracket[] = {0x0,0x0,0xf0,0xf0,0xc,0xc,0x3,0x3,0x0,0x0,0x0,0x0,0x0,0x3,0x3,0xc,0xc,0x30,0x30,0x0,0x0,0x0};
const uint8_t page2_close_simple_bracket[] = {0x0,0x0,0x3,0x3,0xc,0xc,0xf0,0xf0,0x0,0x0,0x0,0x0,0x0,0x30,0x30,0xc,0xc,0x3,0x3,0x0,0x0,0x0};
const uint8_t page2_star[] = {0x30,0x30,0xc0,0xc0,0xfc,0xfc,0xc0,0xc0,0x30,0x30,0x0,0x3,0x3,0x0,0x0,0xf,0xf,0x0,0x0,0x3,0x3,0x0};
const uint8_t page2_plus[] = {0xc0,0xc0,0xc0,0xc0,0xfc,0xfc,0xc0,0xc0,0xc0,0xc0,0x0,0x0,0x0,0x0,0x0,0xf,0xf,0x0,0x0,0x0,0x0,0x0};
const uint8_t page2_comma[] = {0x0,0x0,0x0,0x0,0x0,0x0,0x0,0x0,0x0,0x0,0x0,0x0,0x0,0x33,0x33,0xf,0xf,0x0,0x0,0x0,0x0,0x0};
const uint8_t page2_minus[] = {0xc0,0xc0,0xc0,0xc0,0xc0,0xc0,0xc0,0xc0,0xc0,0xc0,0x0,0x0,0x0,0x0,0x0,0x0,0x0,0x0,0x0,0x0,0x0,0x0};
const uint8_t page2_dot[] = {0x0,0x0,0x0,0x0,0x0,0x0,0x0,0x0,0x0,0x0,0x0,0x0,0x0,0x3c,0x3c,0x3c,0x3c,0x0,0x0,0x0,0x0,0x0};
const uint8_t page2_forward_slash[] = {0x0,0x0,0x0,0x0,0xc0,0xc0,0x30,0x30,0xc,0xc,0x0,0xc,0xc,0x3,0x3,0x0,0x0,0x0,0x0,0x0,0x0,0x0};
const uint8_t page2_zero[] = {0xfc,0xfe,0x7,0x83,0xc3,0xe3,0x73,0x3f,0xfe,0xfc,0x0,0xf,0x1f,0x3f,0x33,0x31,0x30,0x30,0x38,0x1f,0xf,0x0};
const uint8_t page2_one[] = {0x0,0x0,0xc,0xc,0xff,0xff,0x0,0x0,0x0,0x0,0x0,0x0,0x0,0x30,0x30,0x3f,0x3f,0x30,0x30,0x0,0x0,0x0};
const uint8_t page2_two[] = {0xc,0xe,0x7,0x3,0x3,0x83,0xc3,0xe7,0x7e,0x3c,0x0,0x30,0x38,0x3c,0x3e,0x37,0x33,0x31,0x30,0x30,0x30,0x0};
const uint8_t page2_three[] = {0x3,0x3,0x3,0x3,0x33,0x73,0xff,0xcf,0x87,0x3,0x0,0xc,0x1c,0x38,0x30,0x30,0x30,0x30,0x38,0x1f,0xf,0x0};
const uint8_t page2_four[] = {0xc0,0xe0,0x70,0x38,0x1c,0xe,0xff,0xff,0x0,0x0,0x0,0x3,0x3,0x3,0x3,0x3,0x3,0x3f,0x3f,0x3,0x3,0x0};
const uint8_t page2_five[] = {0x3f,0x3f,0x33,0x33,0x33,0x33,0x33,0x33,0xe3,0xc3,0x0,0xc,0x1c,0x38,0x30,0x30,0x30,0x30,0x38,0x1f,0xf,0x0};
const uint8_t page2_six[] = {0xf0,0xf8,0xdc,0xce,0xc7,0xc3,0xc3,0xc3,0x80,0x0,0x0,0xf,0x1f,0x38,0x30,0x30,0x30,0x30,0x38,0x1f,0xf,0x0};
const uint8_t page2_seven[] = {0x3,0x3,0x3,0x83,0xc3,0xe3,0x73,0x3b,0x1f,0xf,0x0,0x0,0x0,0x3f,0x3f,0x1,0x0,0x0,0x0,0x0,0x0,0x0};
const uint8_t page2_eight[] = {0x3c,0x7e,0xe7,0xc3,0xc3,0xc3,0xc3,0xe7,0x7e,0x3c,0x0,0xf,0x1f,0x38,0x30,0x30,0x30,0x30,0x38,0x1f,0xf,0x0};
const uint8_t page2_nine[] = {0x3c,0x7e,0xe7,0xc3,0xc3,0xc3,0xc3,0xe7,0xfe,0xfc,0x0,0x0,0x0,0x30,0x30,0x30,0x38,0x1c,0xe,0x7,0x3,0x0};
const uint8_t page2_colon[] = {0x0,0x0,0x3c,0x3c,0x3c,0x3c,0x0,0x0,0x0,0x0,0x0,0x0,0x0,0xf,0xf,0xf,0xf,0x0,0x0,0x0,0x0,0x0};
const uint8_t page2_semi_colon[] = {0x0,0x0,0x3c,0x3c,0x3c,0x3c,0x0,0x0,0x0,0x0,0x0,0x0,0x0,0x33,0x33,0xf,0xf,0x0,0x0,0x0,0x0,0x0};
const uint8_t page2_less_than[] = {0xc0,0xc0,0x30,0x30,0xc,0xc,0x3,0x3,0x0,0x0,0x0,0x0,0x0,0x3,0x3,0xc,0xc,0x30,0x30,0x0,0x0,0x0};
const uint8_t page2_equals_to[] = {0x30,0x30,0x30,0x30,0x30,0x30,0x30,0x30,0x30,0x30,0x0,0x3,0x3,0x3,0x3,0x3,0x3,0x3,0x3,0x3,0x3,0x0};
const uint8_t page2_greater_than[] = {0x0,0x0,0x3,0x3,0xc,0xc,0x30,0x30,0xc0,0xc0,0x0,0x0,0x0,0x30,0x30,0xc,0xc,0x3,0x3,0x0,0x0,0x0};
const uint8_t page2_question[] = {0xc,0xc,0x3,0x3,0x3,0x3,0xc3,0xc3,0x3c,0x3c,0x0,0x0,0x0,0x0,0x0,0x33,0x33,0x0,0x0,0x0,0x0,0x0};
const uint8_t page2_at_the_rate[] = {0xc,0xc,0xc3,0xc3,0xc3,0xc3,0x3,0x3,0xfc,0xfc,0x0,0xf,0xf,0x30,0x30,0x3f,0x3f,0x30,0x30,0xf,0xf,0x0};
const uint8_t page2_A[] = {0xfc,0xfe,0x7,0x3,0x3,0x3,0x3,0x7,0xfe,0xfc,0x0,0x3f,0x3f,0x3,0x3,0x3,0x3,0x3,0x3,0x3f,0x3f,0x0};
const uint8_t page2_B[] = {0xff,0xff,0xc3,0xc3,0xc3,0xc3,0xc3,0xe7,0xfe,0x3c,0x0,0x3f,0x3f,0x30,0x30,0x30,0x30,0x30,0x39,0x1F,0xf,0x0};
const uint8_t page2_C[] = {0xfc,0xfe,0x7,0x3,0x3,0x3,0x3,0x7,0xe,0xc,0x0,0xf,0x1f,0x38,0x30,0x30,0x30,0x30,0x38,0x1c,0xc,0x0};
const uint8_t page2_D[] = {0xff,0xff,0x3,0x3,0x3,0x3,0xe,0xc,0xf8,0xf0,0x0,0x3f,0x3f,0x30,0x30,0x30,0x30,0x1c,0xc,0x7,0x3,0x0};
const uint8_t page2_E[] = {0xff,0xff,0xc3,0xc3,0xc3,0xc3,0xc3,0xc3,0x3,0x3,0x0,0x3f,0x3f,0x30,0x30,0x30,0x30,0x30,0x30,0x30,0x30,0x0};
const uint8_t page2_F[] = {0xff,0xff,0xc3,0xc3,0xc3,0xc3,0xc3,0xc3,0x3,0x3,0x0,0x3f,0x3f,0x0,0x0,0x0,0x0,0x0,0x0,0x0,0x0,0x0};
const uint8_t page2_G[] = {0xfc,0xfe,0x7,0x3,0xc3,0xc3,0xc3,0xc7,0xce,0xcc,0x0,0xf,0x1f,0x30,0x30,0x30,0x30,0x30,0x30,0x3f,0x3f,0x0};
const uint8_t page2_H[] = {0xff,0xff,0xc0,0xc0,0xc0,0xc0,0xc0,0xc0,0xff,0xff,0x0,0x3f,0x3f,0x0,0x0,0x0,0x0,0x0,0x0,0x3f,0x3f,0x0};
const uint8_t page2_I[] = {0x0,0x0,0x3,0x3,0xff,0xff,0x3,0x3,0x0,0x0,0x0,0x0,0x0,0x30,0x30,0x3f,0x3f,0x30,0x30,0x0,0x0,0x0};
const uint8_t page2_J[] = {0x0,0x0,0x0,0x0,0x3,0x3,0xff,0xff,0x3,0x3,0x0, 0xc,0x1c,0x38,0x30,0x30,0x38,0x1f,0xf,0x0,0x0,0x0};
const uint8_t page2_K[] = {0xff,0xff,0xc0,0xe0,0x30,0x38,0xc,0xe,0x7,0x3,0x0,0x3f,0x3f,0x0,0x01,0x3,0x7,0xc,0x1c,0x38,0x30,0x0};
const uint8_t page2_L[] = {0xff,0xff,0x0,0x0,0x0,0x0,0x0,0x0,0x0,0x0,0x0,0x3f,0x3f,0x30,0x30,0x30,0x30,0x30,0x30,0x30,0x30,0x0};
const uint8_t page2_M[] = {0xff,0xff,0xe,0x1c,0xf8,0xf8,0x1c,0xe,0xff,0xff,0x0,0x3f,0x3f,0x0,0x0,0x0,0x0,0x0,0x0,0x3f,0x3f,0x0};
const uint8_t page2_N[] = {0xff,0xff,0x38,0x30,0xe0,0xc0,0x80,0x0,0xff,0xff,0x0,0x3f,0x3f,0x0,0x0,0x0,0x0,0x3,0x3,0x3f,0x3f,0x0};
const uint8_t page2_O[] = {0xfc,0xfe,0x7,0x3,0x3,0x3,0x3,0x7,0xfe,0xfc,0x0,0xf,0x1f,0x38,0x30,0x30,0x30,0x30,0x38,0x1f,0xf,0x0};
const uint8_t page2_P[] = {0xff,0xff,0xc3,0xc3,0xc3,0xc3,0xc3,0xe7,0x7e,0x3c,0x0,0x3f,0x3f,0x0,0x0,0x0,0x0,0x0,0x0,0x0,0x0,0x0};
const uint8_t page2_Q[] = {0xfc,0xfe,0x7,0x3,0x3,0x3,0x3,0x7,0xfe,0xfc,0x0,0xf,0x1f,0x38,0x30,0x33,0x33,0xc,0xc,0x3b,0x33,0x0};
const uint8_t page2_R[] = {0xff,0xff,0xc3,0xc3,0xc3,0xc3,0xc3,0xe7,0x7e,0x3c,0x0,0x3f,0x3f,0x0,0x0,0x3,0x3,0xc,0xc,0x30,0x30,0x0};
const uint8_t page2_S[] = {0x3c,0x7e,0xe7,0xc3,0xc3,0xc3,0xc3,0xc3,0x83,0x3,0x0,0x30,0x30,0x30,0x30,0x30,0x30,0x30,0x31,0x1f,0xf,0x0};
const uint8_t page2_T[] = {0x3,0x3,0x3,0x3,0xff,0xff,0x3,0x3,0x3,0x3,0x0,0x0,0x0,0x0,0x0,0x3f,0x3f,0x0,0x0,0x0,0x0,0x0};
const uint8_t page2_U[] = {0xff,0xff,0x0,0x0,0x0,0x0,0x0,0x0,0xff,0xff,0x0,0xf,0x1f,0x38,0x30,0x30,0x30,0x30,0x38,0x1f,0xf,0x0};
const uint8_t page2_V[] = {0xff,0xff,0x0,0x0,0x0,0x0,0x0,0x0,0xff,0xff,0x0,0x3,0x7,0xe,0x1c,0x38,0x38,0x1c,0xe,0x7,0x3,0x0};
const uint8_t page2_W[] = {0xff,0xff,0x0,0x0,0xc0,0xc0,0x0,0x0,0xff,0xff,0x0,0xf,0x1f,0x38,0x3c,0x1f,0x1f,0x3c,0x38,0x1f,0xf,0x0};
const uint8_t page2_X[] = {0xf,0xf,0x30,0x30,0xc0,0xc0,0x30,0x30,0xf,0xf,0x0,0x3c,0x3c,0x3,0x3,0x0,0x0,0x3,0x3,0x3c,0x3c,0x0};
const uint8_t page2_Y[] = {0x3f,0x3f,0xc0,0xc0,0x0,0x0,0xc0,0xc0,0x3f,0x3f,0x0,0x0,0x0,0x0,0x0,0x3f,0x3f,0x0,0x0,0x0,0x0,0x0};
const uint8_t page2_Z[] = {0x3,0x3,0x3,0x3,0xc3,0xc3,0x33,0x33,0xf,0xf,0x0,0x3c,0x3c,0x33,0x33,0x30,0x30,0x30,0x30,0x30,0x30,0x0};
const uint8_t page2_open_straight_bracket[] = {0x0,0x0,0xff,0xff,0x3,0x3,0x3,0x3,0x0,0x0,0x0,0x0,0x0,0x3f,0x3f,0x30,0x30,0x30,0x30,0x0,0x0,0x0};
const uint8_t page2_close_straight_bracket[] = {0x0,0x0,0x3,0x3,0x3,0x3,0xff,0xff,0x0,0x0,0x0,0x0,0x0,0x30,0x30,0x30,0x30,0x3f,0x3f,0x0,0x0,0x0};
const uint8_t page2_XOR[] = {0x30,0x30,0xc,0xc,0x3,0x3,0xc,0xc,0x30,0x30,0x0,0x0,0x0,0x0,0x0,0x0,0x0,0x0,0x0,0x0,0x0,0x0};
const uint8_t page2_underscore[] = {0x0,0x0,0x0,0x0,0x0,0x0,0x0,0x0,0x0,0x0,0x0,0x30,0x30,0x30,0x30,0x30,0x30,0x30,0x30,0x30,0x30,0x0};
const uint8_t page2_a[] = {0x0,0x0,0x30,0x30,0x30,0x30,0x30,0x30,0xc0,0xc0,0x0,0xc,0xc,0x33,0x33,0x33,0x33,0x33,0x33,0x3f,0x3f,0x0};
const uint8_t page2_b[] = {0xff,0xff,0xc0,0xc0,0x30,0x30,0x30,0x30,0xc0,0xc0,0x0,0x3f,0x3f,0x30,0x30,0x30,0x30,0x30,0x30,0xf,0xf,0x0};
const uint8_t page2_c[] = {0xc0,0xc0,0x30,0x30,0x30,0x30,0x30,0x30,0x0,0x0,0x0,0xf,0xf,0x30,0x30,0x30,0x30,0x30,0x30,0xc,0xc,0x0};
const uint8_t page2_d[] = {0xc0,0xc0,0x30,0x30,0x30,0x30,0xc0,0xc0,0xff,0xff,0x0,0xf,0xf,0x30,0x30,0x30,0x30,0x30,0x30,0x3f,0x3f,0x0};
const uint8_t page2_e[] = {0xc0,0xc0,0x30,0x30,0x30,0x30,0x30,0x30,0xc0,0xc0,0x0,0xf,0xf,0x33,0x33,0x33,0x33,0x33,0x33,0x3,0x3,0x0};
const uint8_t page2_f[] = {0xc0,0xc0,0xfc,0xfc,0xc3,0xc3,0x3,0x3,0xc,0xc,0x0,0x0,0x0,0x3f,0x3f,0x0,0x0,0x0,0x0,0x0,0x0,0x0};
const uint8_t page2_g[] = {0xf0,0xf0,0xc,0xc,0xc,0xc,0xc,0xc,0xfc,0xfc,0x0,0x0,0x0,0x33,0x33,0x33,0x33,0x33,0x33,0xf,0xf,0x0};
const uint8_t page2_h[] = {0xff,0xff,0xc0,0xc0,0x30,0x30,0x30,0x30,0xc0,0xc0,0x0,0x3f,0x3f,0x0,0x0,0x0,0x0,0x0,0x0,0x3f,0x3f,0x0};
const uint8_t page2_i[] = {0x0,0x0,0x30,0x30,0xf3,0xf3,0x0,0x0,0x0,0x0,0x0,0x0,0x0,0x30,0x30,0x3f,0x3f,0x30,0x30,0x0,0x0,0x0};
const uint8_t page2_j[] = {0x0,0x0,0x0,0x0,0x30,0x30,0xf3,0xf3,0x0,0x0,0x0,0xc,0xc,0x30,0x30,0x30,0x30,0xf,0xf,0x0,0x0,0x0};
const uint8_t page2_k[] = {0xff,0xff,0x0,0x0,0xc0,0xc0,0x30,0x30,0x0,0x0,0x0,0x3f,0x3f,0x3,0x3,0xc,0xc,0x30,0x30,0x0,0x0,0x0};
const uint8_t page2_l[] = {0x0,0x0,0x3,0x3,0xff,0xff,0x0,0x0,0x0,0x0,0x0,0x0,0x0,0x30,0x30,0x3f,0x3f,0x30,0x30,0x0,0x0,0x0};
const uint8_t page2_m[] = {0xf0,0xf0,0x30,0x30,0xc0,0xc0,0x30,0x30,0xc0,0xc0,0x0,0x3f,0x3f,0x0,0x0,0x3,0x3,0x0,0x0,0x3f,0x3f,0x0};
const uint8_t page2_n[] = {0xf0,0xf0,0xc0,0xc0,0x30,0x30,0x30,0x30,0xc0,0xc0,0x0,0x3f,0x3f,0x0,0x0,0x0,0x0,0x0,0x0,0x3f,0x3f,0x0};
const uint8_t page2_o[] = {0x0,0x0,0xc0,0xc0,0xc0,0xc0,0xc0,0xc0,0x0,0x0,0x0,0xf,0xf,0x30,0x30,0x30,0x30,0x30,0x30,0xf,0xf,0x0};
const uint8_t page2_p[] = {0xf0,0xf0,0x30,0x30,0x30,0x30,0x30,0x30,0xc0,0xc0,0x0,0x3f,0x3f,0x3,0x3,0x3,0x3,0x3,0x3,0x0,0x0,0x0};
const uint8_t page2_q[] = {0xc0,0xc0,0x30,0x30,0x30,0x30,0xc0,0xc0,0xf0,0xf0,0x0,0x0,0x0,0x3,0x3,0x3,0x3,0x3,0x3,0x3f,0x3f,0x0};
const uint8_t page2_r[] = {0xf0,0xf0,0xc0,0xc0,0x30,0x30,0x30,0x30,0xc0,0xc0,0x0,0x3f,0x3f,0x0,0x0,0x0,0x0,0x0,0x0,0x0,0x0,0x0};
const uint8_t page2_s[] = {0xc0,0xc0,0x30,0x30,0x30,0x30,0x30,0x30,0x0,0x0,0x0,0x30,0x30,0x33,0x33,0x33,0x33,0x33,0x33,0xc,0xc,0x0};
const uint8_t page2_t[] = {0x30,0x30,0xff,0xff,0x30,0x30,0x0,0x0,0x0,0x0,0x0,0x0,0x0,0xf,0xf,0x30,0x30,0x30,0x30,0xc,0xc,0x0};
const uint8_t page2_u[] = {0xf0,0xf0,0x0,0x0,0x0,0x0,0x0,0x0,0xf0,0xf0,0x0,0xf,0xf,0x30,0x30,0x30,0x30,0xc,0xc,0x3f,0x3f,0x0};
const uint8_t page2_v[] = {0xf0,0xf0,0x0,0x0,0x0,0x0,0x0,0x0,0xf0,0xf0,0x0,0x3,0x3,0xc,0xc,0x30,0x30,0xc,0xc,0x3,0x3,0x0};
const uint8_t page2_w[] = {0xf0,0xf0,0x0,0x0,0x0,0x0,0x0,0x0,0xf0,0xf0,0x0,0xf,0xf,0x30,0x30,0xf,0xf,0x30,0x30,0xf,0xf,0x0};
const uint8_t page2_x[] = {0x30,0x30,0xc0,0xc0,0x0,0x0,0xc0,0xc0,0x30,0x30,0x0,0x30,0x30,0xc,0xc,0x3,0x3,0xc,0xc,0x30,0x30,0x0};
const uint8_t page2_y[] = {0xf0,0xf0,0x0,0x0,0x0,0x0,0x0,0x0,0xf0,0xf0,0x0,0x0,0x0,0x33,0x33,0x33,0x33,0x33,0x33,0xf,0xf,0x0};
const uint8_t page2_z[] = {0x30,0x30,0x30,0x30,0x30,0x30,0xf0,0xf0,0x30,0x30,0x0,0x30,0x30,0x3c,0x3c,0x33,0x33,0x30,0x30,0x30,0x30,0x0};
const uint8_t page2_open_curly_bracket[] = {0x0,0x0,0xc0,0xc0,0x3c,0x3c,0x3,0x3,0x0,0x0,0x0,0x0,0x0,0x0,0x0,0xf,0xf,0x30,0x30,0x0,0x0,0x0};
const uint8_t page2_close_curly_bracket[] = {0x0,0x0,0x3,0x3,0x3c,0x3c,0xc0,0xc0,0x0,0x0,0x0,0x0,0x0,0x30,0x30,0xf,0xf,0x0,0x0,0x0,0x0,0x0};
const uint8_t page2_OR[] = {0x0,0x0,0x0,0x0,0xff,0xff,0x0,0x0,0x0,0x0,0x0,0x0,0x0,0x0,0x0,0x3f,0x3f,0x0,0x0,0x0,0x0,0x0};


uint8_t *size2_array[96] = {(uint8_t *)&page2_space,(uint8_t *)&page2_tick,(uint8_t *)&page2_double_qoutes,
(uint8_t *)&page2_cross,(uint8_t *)&page2_dollar,(uint8_t *)&page2_percentage,
(uint8_t *)&page2_ampercent,(uint8_t *)&page2_qoute,(uint8_t *)&page2_open_simple_bracket,
(uint8_t *)&page2_close_simple_bracket,(uint8_t *)&page2_star,(uint8_t *)&page2_plus,
(uint8_t *)&page2_comma,(uint8_t *)&page2_minus,(uint8_t *)&page2_dot,
(uint8_t *)&page2_forward_slash,(uint8_t *)&page2_zero,(uint8_t *)&page2_one,
(uint8_t *)&page2_two,(uint8_t *)&page2_three,(uint8_t *)&page2_four,
(uint8_t *)&page2_five,(uint8_t *)&page2_six,(uint8_t *)&page2_seven,
(uint8_t *)&page2_eight,(uint8_t *)&page2_nine,(uint8_t *)&page2_colon,
(uint8_t *)&page2_semi_colon,(uint8_t *)&page2_less_than,(uint8_t *)&page2_equals_to,
(uint8_t *)&page2_greater_than,(uint8_t *)&page2_question,(uint8_t *)&page2_at_the_rate,
(uint8_t *)&page2_A,(uint8_t *)&page2_B,(uint8_t *)&page2_C,
(uint8_t *)&page2_D,(uint8_t *)&page2_E,(uint8_t *)&page2_F,
(uint8_t *)&page2_G,(uint8_t *)&page2_H,(uint8_t *)&page2_I,
(uint8_t *)&page2_J,(uint8_t *)&page2_K,(uint8_t *)&page2_L,
(uint8_t *)&page2_M,(uint8_t *)&page2_N,(uint8_t *)&page2_O,
(uint8_t *)&page2_P,(uint8_t *)&page2_Q,(uint8_t *)&page2_R,
(uint8_t *)&page2_S,(uint8_t *)&page2_T,(uint8_t *)&page2_U,
(uint8_t *)&page2_V,(uint8_t *)&page2_W,(uint8_t *)&page2_X,
(uint8_t *)&page2_Y,(uint8_t *)&page2_Z,(uint8_t *)&page2_open_straight_bracket,
(uint8_t *)&page2_space,(uint8_t *)&page2_close_straight_bracket,(uint8_t *)&page2_XOR,
(uint8_t *)&page2_underscore,(uint8_t *)&page2_space,(uint8_t *)&page2_a,
(uint8_t *)&page2_b,(uint8_t *)&page2_c,(uint8_t *)&page2_d,
(uint8_t *)&page2_e,(uint8_t *)&page2_f,(uint8_t *)&page2_g,
(uint8_t *)&page2_h,(uint8_t *)&page2_i,(uint8_t *)&page2_j,
(uint8_t *)&page2_k,(uint8_t *)&page2_l,(uint8_t *)&page2_m,
(uint8_t *)&page2_n,(uint8_t *)&page2_o,(uint8_t *)&page2_p,
(uint8_t *)&page2_q,(uint8_t *)&page2_r,(uint8_t *)&page2_s,
(uint8_t *)&page2_t,(uint8_t *)&page2_u,(uint8_t *)&page2_v,
(uint8_t *)&page2_w,(uint8_t *)&page2_x,(uint8_t *)&page2_y,
(uint8_t *)&page2_z,(uint8_t *)&page2_open_curly_bracket,(uint8_t *)&page2_OR,
(uint8_t *)&page2_close_curly_bracket,(uint8_t *)&page2_space,(uint8_t *)&page2_space };

const unsigned char ALPHA[95][6] = {
  {0x0,0x0,0x0,0x0,0x0,0x0},		//
  {0x0,0x0,0x4F,0x0,0x0,0x0},		// !
  {0x0,0x7,0x0,0x7,0x0,0x0},		// "
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  {0x46,0x49,0x49,0x49,0x31,0x0},	//S
  //{0x0A,0x2A,0x6A,0x9A,0x0E,0x0A},	//rupee
  {0x1,0x1,0x7F,0x1,0x1,0x0},		//T
  {0x3F,0x40,0x40,0x40,0x3F,0x0},	//U
  {0x1F,0x20,0x40,0x20,0x1F,0x0},	//V
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  {0x0,0x41,0x36,0x8,0x0,0x0}		//}
  
};


const unsigned char zedbee_logo[] = {
  0x00, 0x00, 0x00, 0x00, 0x00, 0x00, 0x00, 0x00, 0x00, 0x00, 0x00, 0x00, 0x00, 0x80, 0xC0, 0xE0,
  0xE0, 0xF0, 0xF0, 0xF0, 0xF0, 0xF0, 0xE0, 0xE0, 0xC0, 0x80, 0x00, 0x00, 0x00, 0x00, 0x00, 0x00,
  0x00, 0x00, 0x00, 0x00, 0x00, 0x00, 0x00, 0x00, 0x00, 0x00, 0xF0, 0xF0, 0xF0, 0xF0, 0xF0, 0xF0,
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  0x3F, 0x3F, 0x31, 0x31, 0x30, 0x00, 0x00, 0x1C, 0x3D, 0x3B, 0x1F, 0x04, 0x00, 0x00, 0x00, 0x00
};

unsigned char COL;
unsigned char PAGE;
void lcd_tx_byte(uint8_t u8Data)
{
  GPIOC->BRR = PIN_D3;
  GPIOD->BRR = 0x805f;
  if(u8Data & (1<<0))
  {
    GPIOD->BSRR = PIN_D0;
  }
  if(u8Data & (1<<1))
  {
    GPIOD->BSRR = PIN_D1;
  }
  if(u8Data & (1<<2))
  {
    GPIOD->BSRR = PIN_D2;
  }
  if(u8Data & (1<<3))
  {
    GPIOC->BSRR = PIN_D3;
  }
  if(u8Data & (1<<4))
  {
    GPIOD->BSRR = PIN_D4;
  }
  if(u8Data & (1<<5))
  {
    GPIOD->BSRR = PIN_D5;
  }
  if(u8Data & (1<<6))
  {
    GPIOD->BSRR = PIN_D6;
  }
  if(u8Data & (1<<7))
  {
    GPIOD->BSRR = PIN_D7;
  }
}

void
LCD_WRITE_CMD(unsigned char cmd)
{
  GPIOD->BRR = GPIO_PIN_13;
  GPIOD->BRR = GPIO_PIN_7;
  lcd_tx_byte(cmd);
  GPIOD->BSRR = GPIO_PIN_7;
  GPIOD->BSRR = GPIO_PIN_13;
}

void
lcd_set_contrast(uint8_t val)
{
  LCD_WRITE_CMD(0x81);
  
  if (val > 63) 
  {
    LCD_WRITE_CMD(63);
  }
  else
  {
    LCD_WRITE_CMD(val);
  }
}

void
LCD_WRITE_DATA(uint8_t data)
{
  GPIOD->BSRR = GPIO_PIN_13;
  GPIOD->BRR = GPIO_PIN_7;
  lcd_tx_byte(data);
  GPIOD->BSRR = GPIO_PIN_7;
  GPIOD->BRR = GPIO_PIN_13;
}

void
lcd_set_cursor(uint8_t line, uint8_t col)
{
  unsigned char msb,lsb;
  msb = (((col & 0xF0) >> 4)| 0x10);            //ColAdd(7:4)
  lsb = (col & 0x0F);                           //ColAdd(3:0)
  LCD_WRITE_CMD(line);
  LCD_WRITE_CMD(msb);
  LCD_WRITE_CMD(lsb);
}


void
lcd_clear(void)
{
  uint8_t row;
  for(row = 0xB0;row < 0xB8;row++)
  {
    lcd_set_cursor(row,0);
    for(uint8_t col = 0;col <128;col++)
    {
      LCD_WRITE_DATA(0x00);
    }
  }
}


void
lcd_init()
{
  GPIOD->BRR = GPIO_PIN_14;
  GPIOD->BSRR = GPIO_PIN_14;
  GPIOD->BRR = GPIO_PIN_13;
  
  LCD_WRITE_CMD(0xAF); // DISPLAY  ON //1
  LCD_WRITE_CMD(0xA2); // SET BIAS=1/9	//3
  LCD_WRITE_CMD(0xA0); //ADC Normal ADC select//2
  LCD_WRITE_CMD(0xCf); // COM Normal sLCD_WRITE_CMD(0xC8); COM SCAN DIRECTION(C63-C0)//4
  LCD_WRITE_CMD(0x40); // INITIAL START LINE//14
  LCD_WRITE_CMD(0x2c); // POWER CONTROL1      boost on//5
  LCD_WRITE_CMD(0x2e); // POWER CONTROL2      regulator on 110	//6
  LCD_WRITE_CMD(0x2F); // POWER CONTROL3      follow on//7
  LCD_WRITE_CMD(0x25); // REGULATOR RESISOR SELECT R2 R1 R0 (Black Picel)//8
  LCD_WRITE_CMD(0x81); // SET REFERENCE VOLTAGE MODE //???//9
  LCD_WRITE_CMD(0x17); // SET REFERENCE VOLTAGE REGISTER  C5 C4 C3 C2 C1 C0:010111 a=17H//10
  LCD_WRITE_CMD(0); // SET
  LCD_WRITE_CMD(0xe0);
  LCD_WRITE_CMD(0xA4); // NORMAL DISPLAY   //11
  LCD_WRITE_CMD(0xA6); // NORMAL DISPLAY     //A6//12
  LCD_WRITE_CMD(0xB7); // 1st PAGE    //1
  LCD_WRITE_CMD(0x17); // SET COLUMN ADDR (H)   //15
  LCD_WRITE_CMD(0x01); // SET COLUMN ADDR (L) 16
  lcd_clear();
  lcd_set_contrast(30);
  display_logo();
  fvDelayms(2000);
}
void
lcd_refresh()
{
   GPIOD->BRR = GPIO_PIN_14;
   GPIOD->BSRR = GPIO_PIN_14;
   GPIOD->BRR = GPIO_PIN_13;
   
   LCD_WRITE_CMD(0xAF); // DISPLAY  ON //1
   LCD_WRITE_CMD(0xA2); // SET BIAS=1/9	//3
   LCD_WRITE_CMD(0xA0); //ADC Normal ADC select//2
   LCD_WRITE_CMD(0xCf); // COM Normal sLCD_WRITE_CMD(0xC8); COM SCAN DIRECTION(C63-C0)//4
   LCD_WRITE_CMD(0x40); // INITIAL START LINE//14
   LCD_WRITE_CMD(0x2c); // POWER CONTROL1      boost on//5
   LCD_WRITE_CMD(0x2e); // POWER CONTROL2      regulator on 110	//6
   LCD_WRITE_CMD(0x2F); // POWER CONTROL3      follow on//7
   LCD_WRITE_CMD(0x25); // REGULATOR RESISOR SELECT R2 R1 R0 (Black Picel)//8
   LCD_WRITE_CMD(0x81); // SET REFERENCE VOLTAGE MODE //???//9
   LCD_WRITE_CMD(0x17); // SET REFERENCE VOLTAGE REGISTER  C5 C4 C3 C2 C1 C0:010111 a=17H//10
   LCD_WRITE_CMD(0); // SET0
   LCD_WRITE_CMD(0xe0);
   LCD_WRITE_CMD(0xA4); // NORMAL DISPLAY   //11
   LCD_WRITE_CMD(0xA6); // NORMAL DISPLAY     //A6//12
   LCD_WRITE_CMD(0xB7); // 1st PAGE    //1
   LCD_WRITE_CMD(0x17); // SET COLUMN ADDR (H)   //15
   LCD_WRITE_CMD(0x01); // SET COLUMN ADDR (L) 16
   lcd_clear();
   lcd_set_contrast(30);
   DisplayParam_data.u16DisplayPrevState  = DisplayParam_data.u16DisplayState+1;
  
}
void
lcd_print_long(uint32_t data,uint8_t u8Length,uint8_t u8Page,uint8_t u8Column,
               uint8_t u8font,uint8_t selection)
{
  uint32_t u32Len = 1;
  uint8_t u8Index = 0;
  PAGE = u8Page;
  COL = u8Column;
  lcd_set_cursor(PAGE,COL);
  for(u8Index = 0;u8Index < u8Length-1;u8Index++)
  {
    u32Len *= 10;
  }
  for(;u32Len>=10;u32Len=u32Len/10)
  {
    
    lcd_print_char(((data/u32Len)%10+0x0030),PAGE,COL,u8font,selection);
  }
  lcd_print_char(((data/u32Len)%10+0x0030),PAGE,COL,u8font,selection);
}


void
lcd_print_char(uint8_t chars,uint8_t u8Page,uint8_t u8Column,
               uint8_t u8Font,uint8_t selection)
{
  PAGE = u8Page;
  COL = u8Column;
  lcd_set_cursor(PAGE,COL);
  switch(u8Font)
  {
  case 0:
    LCD_PRINT_FONT1(chars , selection);
    break;
  default :
    break;
  }
}
void
lcd_print_string_position(uint8_t *str,uint8_t u8Page,uint8_t u8Column,
                          uint8_t position,uint8_t u8Font)
{
  PAGE = u8Page;
  COL = u8Column;
  uint8_t *disp_str = (uint8_t*)(str+ position);
  lcd_set_cursor(u8Page,u8Column);
  switch(u8Font)
  {
  case 0:
    while(*disp_str != '\0')
    {
      LCD_PRINT_FONT1((uint8_t)*disp_str, 0);
      u8Column = u8Column+6;
      lcd_set_cursor(u8Page,u8Column);
      disp_str++;
    }
    break;
  default :
    break;
  }
}
void
lcd_print_float(float fData,uint8_t u8Page,uint8_t u8Column,uint8_t u8Font,
                uint8_t u8Length,uint8_t selection)
{
  uint32_t u32data = 0;
  PAGE = u8Page;
  COL = u8Column;
  lcd_set_cursor(PAGE,COL);
  u32data = (uint32_t)(fData);
  lcd_print_long(u32data,u8Length,PAGE,COL,u8Font,selection);
  lcd_print_char('.',PAGE,COL,u8Font,selection);
  u32data = (uint32_t)((fData - (float)(u32data))*100);
  lcd_print_long(u32data,2,PAGE,COL,u8Font,selection);
}

void
lcd_print_double(float fData,uint8_t u8Page,uint8_t u8Column,uint8_t u8Font,
                 uint8_t u8Length,uint8_t selection)
{
  uint16_t u32data = 0;
  PAGE = u8Page;
  COL = u8Column;
  lcd_set_cursor(PAGE,COL);
  u32data = (uint32_t)(fData);
  lcd_print_long(u32data,u8Length,PAGE,COL,u8Font,selection);
  lcd_print_char('.',PAGE,COL,u8Font,selection);
  fvDelayms(1);
  u32data = (uint32_t)((fData - (float)(u32data))*1000);
  lcd_print_long(u32data,3,PAGE,COL,u8Font,selection);
}

void
twopage_float(float fData,uint8_t u8Page,uint8_t u8Column)
{
  unsigned char buffer[10];
  if(fData == 0)
  {
    LCD_display_text("00.00",u8Column,u8Page);
  }
  else
  {
    ftoa(fData, (char*)buffer, 2);
    LCD_display_text(buffer,u8Column,u8Page);
  }
}


void
lcd_display_image(char *Adata,uint32_t row_value,uint32_t Column,
                  uint32_t startrow,uint32_t startcolumn)
{
  uint32_t row,col,page = startrow;
  lcd_set_cursor(0xb0,0);
  for( row = startrow; row < row_value; row++)
  {
    for(col=startcolumn;col<Column;col++)
    {
      LCD_WRITE_DATA(*((Adata+row*Column)+col));
    }
    page++;
    lcd_set_cursor((page+0xb0),0);
  }
}

void
display_logo()
{
  lcd_display_image((unsigned char*)(zedbee_logo),8,128,0,0);
}

void
Display(unsigned char Font,unsigned char Page_No, unsigned char Col_No,
        unsigned char *MESSAGE , unsigned char Selection)
{
  PAGE = Page_No;
  COL = Col_No;
  lcd_set_cursor(PAGE,COL);
  switch(Font)
  {
    while(1)
    {
    case 0:
      while(*MESSAGE != '\0')
      {
        LCD_PRINT_FONT1(*MESSAGE,Selection);
        MESSAGE++;
      }
      break;
    default :
      break;
    }
  }
}



void
print_page2_text(unsigned char text, uint8_t startcol,uint8_t startpage)
{
  uint8_t u8data;
  uint8_t temp_column = 0;
  uint8_t index = text - 32;
  uint8_t row = 0;
  uint16_t col=startcol;
  uint8_t page = startpage;
  for(row = 0 ; row < 2;row++)
  {
    lcd_set_cursor(row + page,col);
    for(uint8_t i = 0+temp_column; i < 11+temp_column;i++)
    {
      u8data = *(size2_array[index]+(i));
      LCD_WRITE_DATA(u8data);
    }
    temp_column = 11;
  }
}


void
LCD_PAGE_CLEAR(uint16_t page,uint16_t column)
{
  unsigned char j = 0;
  lcd_set_cursor(page,column);
  
  for(j = column; j < 128; j++)
    LCD_WRITE_DATA(0x00);
}

void
LCD_PRINT_FONT1(unsigned char data,unsigned char selection)
{
  unsigned char i,index;
  index	= data - 32;
  LCD_PAGE_COL_CHECK_FONT1();
  
  for(i = 0; i < 6; i++)
  {
    if(selection == 1)
    {
      LCD_WRITE_DATA(~ALPHA[index][i]);
    }
    else
    {
      LCD_WRITE_DATA(ALPHA[index][i]);
    }
    COL += 1;
  }
}

void
LCD_PAGE_COL_CHECK_FONT1(void)
{
  if (COL >= 127)
  {
    PAGE += 1;
    if(PAGE >= 0xB7 + 1)
      lcd_clear();
    COL = 1;
    lcd_set_cursor(PAGE,COL);
  }
}

void
LCD_display_text(unsigned char *text, uint8_t startcol,uint8_t startpage)
{
  uint8_t *ptr = text;
  uint8_t len = strlen((char const *)ptr);
  uint8_t col = startcol;
  for(int i = 0;i<len;i++)
  {
    print_page2_text(ptr[i],col,startpage);
    col+=11;
  }
}


void fvglcdMenuCommonHandler(void)
{
  uint8_t u8StopError = 0;
  uint8_t u8UVError = 0;
  uint8_t * disp_ip = NULL;
  uint8_t * disp_sub = NULL;
  uint8_t * disp_gat = NULL;
  uint8_t * disp_sip = NULL;
  struct sensor_card_data_tag sensor_card_data_rcv;

  uint16_t version_number = get_product_version();
  float tvoc_val = 0;
  //tvoc_val=(float)((sensor_card_data_rcv.tvoc)*0.001);
  fvFACIAQRead(&stIAQdata);
  fvRS485ParamsRead(&glcdRS485Params);
  fvMenuItemsRead(& display_set);
  
  set_ping_vav_screen(0);
  sensor_card_data_read(&sensor_card_data_rcv);
  //tvoc_val = (float)(((sensor_card_data_rcv.tvoc)*0.001) * 1000);
  if(DisplayParam_data.u16DisplayPrevState != DisplayParam_data.u16DisplayState)
  {
    lcd_clear();
    switch(DisplayParam_data.u16DisplayState)
    {
  
  case DISP_PAGE0:
      Display(0,RT_STR_VER,DISP_STR_HOR,  "    CHILLER-1  ",0);
      Display(0,IT_STR_VER,DISP_STR_HOR,  "CHILLER A/S:",0);
      Display(0,OT_STR_VER,DISP_STR_HOR,  "RUN STATUS :",0);
      Display(0,FLOW_STR_VER,DISP_STR_HOR,"ACTIVE COOL:",0);
      Display(0,FLOW_STR_VER,107,  "C",0);
   break;
   case DISP_PAGE1:
      Display(0,RT_STR_VER,DISP_STR_HOR,  "    CHILLER-2  ",0);
      Display(0,IT_STR_VER,DISP_STR_HOR,  "CHILLER A/S:",0);
      Display(0,OT_STR_VER,DISP_STR_HOR,  "RUN STATUS :",0);
      Display(0,FLOW_STR_VER,DISP_STR_HOR,"ACTIVE COOL:",0);
      Display(0,FLOW_STR_VER,107,  "C",0);
   break;
   
  
    case DISP_PAGE2:
      Display(0,RT_STR_VER,DISP_STR_HOR,  "    CHILLER-3  ",0);
      Display(0,IT_STR_VER,DISP_STR_HOR,  "CHILLER A/S:",0);
      Display(0,OT_STR_VER,DISP_STR_HOR,  "RUN STATUS :",0);
      Display(0,FLOW_STR_VER,DISP_STR_HOR,"ACTIVE COOL:",0);
      

      Display(0,FLOW_STR_VER,107,  "C",0);
      
      break;
  
  
    case DISP_PAGE3:
      Display(0, UUID_VER_VER, UUID_VER_HOR,"UUID:",0);
      Display(0, IP_VER_VER, IP_VER_HOR,"IP:",0);
      lcd_print_char('.',IP_VER_VER,36,0,0);
      lcd_print_char('.',IP_VER_VER,60,0,0);
      lcd_print_char('.',IP_VER_VER,84,0,0);
       Display(0, SERVER_VER_VER, SERVER_VER_HOR,"SIP:",0);
      lcd_print_char('.',SERVER_VER_VER,42,0,0);
      lcd_print_char('.',SERVER_VER_VER,66,0,0);
      lcd_print_char('.',SERVER_VER_VER,90,0,0);
      Display(0, SUB_VER_VER, SUB_VER_HOR,"SUB:",0);
      lcd_print_char('.',SUB_VER_VER,42,0,0);
      lcd_print_char('.',SUB_VER_VER,66,0,0);
      lcd_print_char('.',SUB_VER_VER,90,0,0);
      Display(0, GAT_VER_VER, GAT_VER_HOR,"GAT:",0);
      lcd_print_char('.',GAT_VER_VER,42,0,0);
      lcd_print_char('.',GAT_VER_VER,66,0,0);
      lcd_print_char('.',GAT_VER_VER,90,0,0);
      break;
  
    case DISP_PAGE4:
      Display(0, 0xB1, 1,"Ethernet Error:",0);
      Display(0, UVS_VER_VER, UVS_VER_HOR,"Status :",0);
      break;
    default:
      break;
    }
    DisplayParam_data.u16DisplayPrevState = DisplayParam_data.u16DisplayState;
  }
  switch(DisplayParam_data.u16DisplayState)
  {
   case DISP_PAGE0:
struct stChillerholdregister chil;
  struct stChillerCoildata coildata;
   fvReadChillerHoldParams(&chil,1);
   fvReadChillerCoilParams(&coildata,1);
      
         if(coildata.coil8==1){Display(0,IT_STR_VER,80,   "ON  ",0);}
                          else {Display(0,IT_STR_VER,80,   "OFF ",0);}
         if (coildata.coil3==1){Display(0,OT_STR_VER,80, "ON ",0);}
                            else {Display(0,OT_STR_VER,80, "OFF ",0);}
         lcd_print_float((float)(chil.ActiveCoolHeatSetpointTemp/100) ,FLOW_STR_VER,75,0,2,0);
        
         break;
    case DISP_PAGE1:
    struct stChillerholdregister chil2;
  struct stChillerCoildata coildata2;
   fvReadChillerHoldParams(&chil2,2);
   fvReadChillerCoilParams(&coildata2,2);
      
         if(coildata2.coil8==1){Display(0,IT_STR_VER,80,   "ON  ",0);}
                          else {Display(0,IT_STR_VER,80,   "OFF ",0);}
         if (coildata2.coil3==1){Display(0,OT_STR_VER,80, "ON ",0);}
                            else {Display(0,OT_STR_VER,80, "OFF ",0);}
         lcd_print_float((float)(chil2.ActiveCoolHeatSetpointTemp/100) ,FLOW_STR_VER,75,0,2,0);
         break;
         
       
         
          case DISP_PAGE2:
  struct stChillerholdregister chil3;
  struct stChillerCoildata coildata3;
   fvReadChillerHoldParams(&chil3,3);
   fvReadChillerCoilParams(&coildata3,3);
      
         if(coildata3.coil8==1){Display(0,IT_STR_VER,80,   "ON  ",0);}
                          else {Display(0,IT_STR_VER,80,   "OFF ",0);}
         if (coildata3.coil3==1){Display(0,OT_STR_VER,80, "ON ",0);}
                            else {Display(0,OT_STR_VER,80, "OFF ",0);}
         lcd_print_float((float)(chil3.ActiveCoolHeatSetpointTemp/100) ,FLOW_STR_VER,75,0,2,0);
     
    break;
       
 
  case DISP_PAGE3:
    disp_ip = GetIP();
    disp_sub = GetSubnetMask();
    disp_gat = GetGetway();
    disp_sip = GetServerIP();
    lcd_print_string_position(CONFIG_CLIENT_ID_NAME,0xB1,30, 10,0);
    lcd_print_long((uint32_t)*(disp_ip),3,IP_VER_VER,IP_VALUE_HOR,0,0);
    lcd_print_long((uint32_t)*(disp_ip+1),3,IP_VER_VER,42,0,0);
    lcd_print_long((uint32_t)*(disp_ip+2),3,IP_VER_VER,66,0,0);
    lcd_print_long((uint32_t)*(disp_ip+3),3,IP_VER_VER,90,0,0);
     lcd_print_long((uint32_t)*(disp_sip),3,SERVER_VER_VER,SERVER_VALUE_HOR,0,0);
    lcd_print_long((uint32_t)*(disp_sip+1),3,SERVER_VER_VER,48,0,0);
    lcd_print_long((uint32_t)*(disp_sip+2),3,SERVER_VER_VER,72,0,0);
    lcd_print_long((uint32_t)*(disp_sip+3),3,SERVER_VER_VER,96,0,0);
    lcd_print_long((uint32_t)*(disp_sub),3,SUB_VER_VER,SUB_VALUE_HOR,0,0);
    lcd_print_long((uint32_t)*(disp_sub+1),3,SUB_VER_VER,48,0,0);
    lcd_print_long((uint32_t)*(disp_sub+2),3,SUB_VER_VER,72,0,0);
    lcd_print_long((uint32_t)*(disp_sub+3),3,SUB_VER_VER,96,0,0);
    
    lcd_print_long((uint32_t)*(disp_gat),3,GAT_VER_VER,GAT_VALUE_HOR,0,0);
    lcd_print_long((uint32_t)*(disp_gat+1),3,GAT_VER_VER,48,0,0);
    lcd_print_long((uint32_t)*(disp_gat+2),3,GAT_VER_VER,72,0,0);
    lcd_print_long((uint32_t)*(disp_gat+3),3,GAT_VER_VER,96,0,0);
    break;
  
  case DISP_PAGE4:
    if( Get_mqtt_client_status() >1)
    {
      Display(0,0xB2,50, "Connected   ",0);
    }
    else
    {
      Display(0,0xB2,50, "Disconnected",0);
    }
  default:
    break;
  }
}

void fvMenuPageInc(void)
{
  if(++DisplayParam_data.u16DisplayState > DISP_PAGE4)
  {
    DisplayParam_data.u16DisplayState = DISP_PAGE0;
  }
}

void fvMenuPageDec(void)
{
  if(DisplayParam_data.u16DisplayState > DISP_PAGE0)
  {
    DisplayParam_data.u16DisplayState--;
  }
  else
  {
    DisplayParam_data.u16DisplayState = DISP_PAGE4;
  }
}
uint16_t fu16GetDisplayState(void)
{
  return DisplayParam_data.u16DisplayState;
}